## Kconfig
```kconfig
config MANIKIN_BLE_PROTOCOL
    bool "Manikin BLE protocol support"
    depends on BT
    help
      Enable driver for the Manikin BLE protocol.

if MANIKIN_BLE_PROTOCOL

config MANIKIN_BLE_MAX_ATT_SIZE
    int "Max ATT size in (bytes)"
    default 185
    range 64 4096
    help
      Size of the internal receive buffer used by the Manikin BLE protocol.

config MANIKIN_BLE_MAX_TEMPORARY_BUFFER_SIZE
    int "Transmit buffer size (bytes)"
    default 512
    range 64 4096
    help
      Size of the internal transmit buffer used by the Manikin BLE protocol.

config MANIKIN_BLE_MAX_BUFFERS
    int "Maximum number of internal buffers"
    default 4
    range 1 16
    help
      Maximum number of internal buffers that can be used simultaneously
      by the Manikin BLE protocol.


config MANIKIN_BLE_MAX_SUBSCRIBERS
    int "Maximum number of subscribers"
    default 4
    range 1 16
    help
      Maximum number of subscribers tasks that can access api from the Manikin BLE protocol.

endif # MANIKIN_BLE_PROTOCOL
```

## device/tests/manikin_ble_serializer/testcase.yaml
```yaml
tests:
  manikin_ble_protocol.serializer.runtime:
    tags: drivers manikin_ble_serializer
    harness: ztest
    timeout: 60        # optional but nice
```

## device/tests/manikin_ble_serializer_decode/testcase.yaml
```yaml
tests:
  manikin_ble_protocol.serializer_decode.runtime:
    tags: drivers manikin_ble_serializer_decode
    harness: ztest
    timeout: 60        # optional but nice
```

## device/tests/manikin_ble_serializer_encode/testcase.yaml
```yaml
tests:
  manikin_ble_protocol.serializer_encode.runtime:
    tags: drivers manikin_ble_serializer_encode
    harness: ztest
    timeout: 60        # optional but nice
```
